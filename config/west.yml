## config/west.yml
```yaml
manifest:
  remotes:
    - name: zmkfirmware
      url-base: https://github.com/zmkfirmware
    - name: petejohanson
      url-base: https://github.com/petejohanson
    - name: mctechnology17
      url-base: https://github.com/mctechnology17

  projects:
    - name: zmk
      remote: zmkfirmware
      revision: main
      import: app/west.yml
    - name: cirque-input-module
      remote: petejohanson
      revision: main
    - name: zmk-cirque-adapter
      remote: mctechnology17
      revision: main

  self:
    path: config
```
